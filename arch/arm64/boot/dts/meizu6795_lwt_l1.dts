/*
 * Mediatek's MT6795 SoC device tree source
 *
 * Copyright (c) 2013 MediaTek Co., Ltd.
 *              http://www.mediatek.com
 *
 */

/dts-v1/;

/include/ "mt6795.dtsi"
/include/ "cust_eint.dtsi"
/include/ "mt6795-m85-i2c.dtsi"
/ {

	memory@00000000 {
		device_type = "memory";
		reg = <0 0x40000000 0 0x1E800000>;
	};

};
