## drivers/misc/mediatek/fingerprint/Kconfig
```kconfig
#
# Tablet driver configuration
#
menuconfig INPUT_FINGERPRINT
	bool "Fingerprint"
	default n
	help
	  Say Y here, and a list of supported fingerprint sensor will be displayed.
	  This option doesn't affect the kernel.

	  If unsure, say Y.

if INPUT_FINGERPRINT

source "drivers/misc/mediatek/fingerprint/goodix/Kconfig"
source "drivers/misc/mediatek/fingerprint/oem_nav/Kconfig"


endif
```

## drivers/misc/mediatek/flight/Kconfig
```kconfig
config MTK_FLIGHT
  bool CONFIG_MTK_FLIGHT
  default n
  help
    CONFIG_MTK_FLIGHT
```

## drivers/motor/Kconfig
```kconfig
menu "Motor Ti drv drivers"
	depends on ANDROID_TIMED_OUTPUT

config TI_DRV_MOTOR
	tristate "Support Ti drv motor"
	depends on ANDROID_TIMED_OUTPUT
endmenu 
```

## drivers/tspdrv/Kconfig
```kconfig
menu "TouchSense driver support"

config TSPDRV
	tristate "TouchSense driver support"

endmenu
```
